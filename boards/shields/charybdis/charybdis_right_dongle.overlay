#include "charybdis.dtsi"
#include "charybdis_3610.dtsi"
#include "split_input_common.dtsi"

&default_transform {
    col-offset = <5>;
};

&spi0 {
    status = "okay";
};

&trackball {
    status = "okay";
};

&trackball_split {
    device = <&trackball>;
};
