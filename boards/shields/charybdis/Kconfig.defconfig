## boards/shields/charybdis/Kconfig.defconfig
```kconfig
if SHIELD_CHARYBDIS_RIGHT || SHIELD_CHARYBDIS_DONGLE
    config ZMK_SPLIT_ROLE_CENTRAL
        default y

    config ZMK_KEYBOARD_NAME
        default "Charybdis"
endif

if SHIELD_CHARYBDIS_LEFT || SHIELD_CHARYBDIS_RIGHT || SHIELD_CHARYBDIS_RIGHT_DONGLE || SHIELD_CHARYBDIS_DONGLE
    config ZMK_SPLIT
        default y
endif

if SHIELD_CHARYBDIS_RIGHT || SHIELD_CHARYBDIS_RIGHT_DONGLE || SHIELD_CHARYBDIS_DONGLE
    config ZMK_POINTING
        default y
    config INPUT
        default y
endif

if SHIELD_CHARYBDIS_RIGHT || SHIELD_CHARYBDIS_RIGHT_DONGLE
    config SPI
        default y
    config PMW3610_ALT
        default y
endif

if SHIELD_CHARYBDIS_DONGLE
if ZMK_DISPLAY
    config I2C
        default y

    config SSD1306
        default y
endif
endif
```

## config/west.yml
```yaml
default:
manifest:
  remotes:
    - name: zmkfirmware
      url-base: https://github.com/zmkfirmware
    - name: englmaxi
      url-base: https://github.com/englmaxi
    - name: badjeff
      url-base: https://github.com/badjeff
  projects:
    - name: zmk
      remote: zmkfirmware
      import: app/west.yml
      revision: 8feeb52e
    - name: zmk-dongle-display
      remote: englmaxi
      revision: 2bb333f
    - name: zmk-pmw3610-driver
      remote: badjeff
      revision: a1a0f35
  self:
    path: config
```
